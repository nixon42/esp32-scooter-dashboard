## sdkconfig.defaults
```kconfig
# ==============================================================================
# ESP32 Scooter Dashboard (Honda Vario 125 K60) - Default Configuration
# Target: ESP32-C3 SuperMini (RISC-V @ 160MHz, 4MB Flash)
# Framework: ESP-IDF v5.3
# ==============================================================================

# Target Silicon Architecture
CONFIG_IDF_TARGET="esp32c3"
CONFIG_IDF_TARGET_ESP32C3=y

# ------------------------------------------------------------------------------
# Flash & SPI Flash Configuration (4MB Flash)
# ------------------------------------------------------------------------------
CONFIG_ESPTOOLPY_FLASHSIZE_4MB=y
CONFIG_ESPTOOLPY_FLASHSIZE="4MB"
CONFIG_ESPTOOLPY_FLASHMODE_DIO=y
CONFIG_ESPTOOLPY_FLASHFREQ_80M=y

# ------------------------------------------------------------------------------
# Partition Table Configuration (Dual-OTA Scheme)
# ------------------------------------------------------------------------------
CONFIG_PARTITION_TABLE_CUSTOM=y
CONFIG_PARTITION_TABLE_CUSTOM_FILENAME="partitions.csv"
CONFIG_PARTITION_TABLE_FILENAME="partitions.csv"
CONFIG_PARTITION_TABLE_OFFSET=0x8000

# ------------------------------------------------------------------------------
# Bluetooth Subsystem (Apache NimBLE)
# ------------------------------------------------------------------------------
CONFIG_BT_ENABLED=y
CONFIG_BT_CONTROLLER_ENABLED=y
CONFIG_BT_BLUEDROID_ENABLED=n
CONFIG_BT_NIMBLE_ENABLED=y

# NimBLE Resource & Role Configuration
CONFIG_BT_NIMBLE_MEM_ALLOC_MODE_INTERNAL=y
CONFIG_BT_NIMBLE_MAX_CONNECTIONS=1
CONFIG_BT_NIMBLE_MAX_BONDS=1
CONFIG_BT_NIMBLE_MAX_CCCDS=8
CONFIG_BT_NIMBLE_HOST_TASK_STACK_SIZE=4096
CONFIG_BT_NIMBLE_ROLE_PERIPHERAL=y
CONFIG_BT_NIMBLE_ROLE_BROADCASTER=y
CONFIG_BT_NIMBLE_ROLE_CENTRAL=n
CONFIG_BT_NIMBLE_ROLE_OBSERVER=n

# ------------------------------------------------------------------------------
# 2.4 GHz RF Software Coexistence (Wi-Fi SoftAP + BLE)
# ------------------------------------------------------------------------------
CONFIG_ESP_COEX_SW_COEXIST_ENABLE=y

# ------------------------------------------------------------------------------
# FreeRTOS Operating System Configuration
# ------------------------------------------------------------------------------
# 1000 Hz Tick Rate (1 tick = 1 ms)
CONFIG_FREERTOS_HZ=1000

# Main Application Task Stack Size
CONFIG_ESP_MAIN_TASK_STACK_SIZE=8192

# Stack Overflow Detection (Canary pattern)
CONFIG_FREERTOS_CHECK_STACKOVERFLOW_CANARY=y

# FreeRTOS Timer & Trace Settings
CONFIG_FREERTOS_TIMER_TASK_STACK_DEPTH=3072
CONFIG_FREERTOS_TIMER_TASK_PRIORITY=1
CONFIG_FREERTOS_USE_TRACE_FACILITY=y
CONFIG_FREERTOS_USE_STATS_FORMATTING_FUNCTIONS=y

# ------------------------------------------------------------------------------
# System & Serial Console Configuration
# ------------------------------------------------------------------------------
CONFIG_ESP_CONSOLE_UART_DEFAULT=y
CONFIG_ESP_CONSOLE_UART=y
CONFIG_LOG_DEFAULT_LEVEL_INFO=y
CONFIG_LOG_COLORS=y

# ------------------------------------------------------------------------------
# Compiler Optimization
# ------------------------------------------------------------------------------
CONFIG_COMPILER_OPTIMIZATION_DEFAULT=y
```
